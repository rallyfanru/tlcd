/*
Подключение экрана:
 
1   +5                                      
2   GND
3   На среднюю ногу потенциометра
4   DB0                                 GPB0

11  DB7                                 GPB7
12  CS1                                 GPA3
13  CS2                                 GPA2
14  RST через резистор на +5
15  R/W                                 GPA6
16  D/i                                 GPA5
17  E                                   GPA7
18  На правую ногу потенциометра
19  +5
20  подсветка, через резистор на GND  
21  --
22  --

*/

/*
#define LCD_CMD_ONOFF 0B0011111100000000
#define LCD_CMD_SETY  0B0100000000000000
#define LCD_CMD_SETX  0B1011100000000000
#define LCD_CMD_WRITE 0B0000000000100000
#define LCD_CMD_READ  0B0000000001100000
*/

//Номера ног на mcp23S17
//обозначение не как в datasheet, а с GPA0(21 нога по datasheet) - 1, GPA1 - 2. Т.е. GPB0 - 9 нога.
#define CS1 3
#define CS2 4
#define DI  6
#define RW  7
#define E   8 
#define DB0 9 
#define DB1 10 
#define DB2 11 
#define DB3 12 
#define DB4 13 
#define DB5 14 
#define DB6 15 
#define DB7 16 


#define cmd_on    (1 << (DB0-1)) | (1 << (DB1-1)) | (1 << (DB2-1)) | (1 << (DB3-1)) | (1 << (DB4-1)) | (1 << (DB5-1))
#define cmd_setx  (1 << (DB7-1)) | (1 << (DB3-1)) | (1 << (DB4-1)) | (1 << (DB5-1))
#define cmd_sety  (1 << (DB6-1))
#define cmd_write (1 << (DI-1))
#define cmd_read  (1 << (DI-1)) | (1 << (RW-1)) //Чтение жестко завязано на конфигурацию ног!


byte font [160] [5] PROGMEM = {
  // font data
    0x00, 0x00, 0x00, 0x00, 0x00,// (space) 0x20
    0x00, 0x00, 0x5F, 0x00, 0x00,// !   0x21
    0x00, 0x07, 0x00, 0x07, 0x00,// "   0x22
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    0x08, 0x1C, 0x2A, 0x08, 0x08, // <- 0x7F
// Вставлено
    0x7C, 0x14, 0x14, 0x14, 0x08,//p    0x80
    0x38, 0x44, 0x44, 0x44, 0x20,//c    0x81
    0x04, 0x04, 0x7c, 0x04, 0x04,//т    0x82
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    0x08, 0x54, 0x34, 0x14, 0x7c,//я    0x8F
// -------------------------------------------------    
    0x7e, 0x11, 0x11, 0x11, 0x7e,//A    0x90
    0x7f, 0x49, 0x49, 0x49, 0x33,//Б    0x91
    0x7f, 0x49, 0x49, 0x49, 0x36,//В    0x92
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    0x46, 0x29, 0x19, 0x09, 0x7f,//Я    0xAF
// маленькие буквы 
    0x20, 0x54, 0x54, 0x54, 0x78,//a    0xB0
    0x3c, 0x4a, 0x4a, 0x49, 0x31,//б    0xB1
    0x7c, 0x54, 0x54, 0x28, 0x00,//в    0xB2
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    0x7c, 0x04, 0x04, 0x04, 0x7c
};


byte tf [16] [16] PROGMEM = {
    0x80, 0x80, 0x80, 0xe0, 0xe0, 0x80, 0x80, 0x80, 0x00, 0x00, 0x00, 0x03, 0x03, 0x00, 0x00, 0x00, // char '+'
    0x00, 0x00, 0x00, 0x00, 0x00, 0x00, 0x00, 0x00, 0x00, 0x00, 0x00, 0xb0, 0x70, 0x00, 0x00, 0x00, // char ','
    0x80, 0x80, 0x80, 0x80, 0x80, 0x80, 0x80, 0x80, 0x00, 0x00, 0x00, 0x00, 0x00, 0x00, 0x00, 0x00, // char '-'
    0x00, 0x00, 0x00, 0x00, 0x00, 0x00, 0x00, 0x00, 0x00, 0x00, 0x00, 0x30, 0x30, 0x00, 0x00, 0x00, // char '.'
    0x00, 0x00, 0x00, 0xc0, 0xf0, 0x3c, 0x0f, 0x03, 0x30, 0x3c, 0x0f, 0x03, 0x00, 0x00, 0x00, 0x00, // char '/'
    0xfc, 0xfe, 0x03, 0x81, 0x61, 0x1b, 0xfe, 0xfc, 0x0f, 0x1f, 0x36, 0x21, 0x20, 0x30, 0x1f, 0x0f, // char '0'
    0x04, 0x04, 0x06, 0xff, 0xff, 0x00, 0x00, 0x00, 0x20, 0x20, 0x20, 0x3f, 0x3f, 0x20, 0x20, 0x20, // char '1'
    0x0c, 0x0e, 0x03, 0x01, 0x81, 0xc3, 0x7e, 0x3c, 0x38, 0x3c, 0x26, 0x23, 0x21, 0x20, 0x20, 0x20, // char '2'
    0x0c, 0x0e, 0x43, 0x41, 0x41, 0x43, 0xfe, 0xbc, 0x0c, 0x1c, 0x30, 0x20, 0x20, 0x30, 0x1f, 0x0f, // char '3'
    0x00, 0xe0, 0xfc, 0x1f, 0x83, 0x80, 0x00, 0x00, 0x0f, 0x0f, 0x08, 0x08, 0x3f, 0x3f, 0x08, 0x08, // char '4'
    0x3f, 0x3f, 0x21, 0x21, 0x21, 0x61, 0xc1, 0x81, 0x0c, 0x1c, 0x30, 0x20, 0x20, 0x30, 0x1f, 0x0f, // char '5'
    0xe0, 0xf8, 0x5c, 0x46, 0x43, 0xc1, 0x81, 0x01, 0x0f, 0x1f, 0x30, 0x20, 0x20, 0x30, 0x1f, 0x0f, // char '6'
    0x01, 0x01, 0x01, 0x01, 0x81, 0xf1, 0x7f, 0x0f, 0x00, 0x00, 0x00, 0x3c, 0x3f, 0x03, 0x00, 0x00, // char '7'
    0x1c, 0xbe, 0xe3, 0x41, 0x41, 0xe3, 0xbe, 0x1c, 0x0f, 0x1f, 0x30, 0x20, 0x20, 0x30, 0x1f, 0x0f, // char '8'
    0x3c, 0x7e, 0xc3, 0x81, 0x81, 0x83, 0xfe, 0xfc, 0x20, 0x20, 0x20, 0x30, 0x18, 0x0e, 0x07, 0x01, // char '9'
    0x00, 0x00, 0x00, 0x60, 0x60, 0x00, 0x00, 0x00, 0x00, 0x00, 0x00, 0x30, 0x30, 0x00, 0x00, 0x00  // char ':
};

void lcd_clear(byte fill);
uint16_t set_data_bits(byte data);
void lcd_on(byte chip);
void lcd_goto(byte x, byte y);
void lcd_write(byte data);
void lcd_bigfont_string (const char *s);
void lcd_bigfont_letter (byte c);
void lcd_vline(byte from_x, byte to_x, byte y);
void lcd_hline(byte from_y, byte to_y, byte x);
void lcd_set_dot(byte x, byte y);
void lcd_cmd(uint16_t cmd);
void set_data_pinmode(uint8_t mode);
uint8_t lcd_read();

MCP mcpchip(0); 

uint16_t chipselect=0;
uint8_t lcd_x=0;
uint8_t lcd_y=0;
uint8_t lcd_chip=1;

const uint8_t newline=1;  //перенос текста на новую строку


uint16_t set_data_bits(byte data){
	
	uint16_t result=0;

	result |= ( (uint16_t)(data & 1) << (DB0 - 1) );
	result |= ( (uint16_t)((data >> 1) & 1) << (DB1 - 1) );
	result |= ( (uint16_t)((data >> 2) & 1) << (DB2 - 1) );
	result |= ( (uint16_t)((data >> 3) & 1) << (DB3 - 1) );
	result |= ( (uint16_t)((data >> 4) & 1) << (DB4 - 1) );
	result |= ( (uint16_t)((data >> 5) & 1) << (DB5 - 1) );
	result |= ( (uint16_t)((data >> 6) & 1) << (DB6 - 1) );
	result |= ( (uint16_t)((data >> 7) & 1) << (DB7 - 1) );

	return result;
}

void lcd_cmd(uint16_t cmd){

    mcpchip.digitalWrite(cmd);   //Команда на включение
    mcpchip.digitalWrite(cmd | (1 << (E-1))); //Дрыг линией Е
    mcpchip.digitalWrite(cmd);   //Линию Е обратно в 0
}

void lcd_on(byte chip=0) {

	uint16_t cspin = 0;

	switch(chip){
		case 1:
			cspin = 1 << (CS1 - 1);
			break;
		
		case 2:
			cspin = 1 << (CS2 - 1);
			break;

		default:
			lcd_on(1);
			lcd_on(2);
			;
	}

	lcd_cmd(cmd_on | cspin);
}

void lcd_clear(byte fill=0){
		for(byte x=0; x<8; x++){
			lcd_goto(x,0);
            for(byte y=0; y<64; y++) lcd_write(fill);
            lcd_goto(x,64); 
            for(byte y=0; y<64; y++) lcd_write(fill);
		}
}

void lcd_get_bites(uint16_t cmd){

    Serial.println("0 1 2 3 4 5 6 7 I W E 1 2");
    Serial.print(((cmd >> DB0-1) & 1));
    Serial.print(" ");
    Serial.print(((cmd >> DB1-1) & 1));
    Serial.print(" ");
    Serial.print(((cmd >> DB2-1) & 1));
    Serial.print(" ");
    Serial.print(((cmd >> DB3-1) & 1));
    Serial.print(" ");
    Serial.print(((cmd >> DB4-1) & 1));
    Serial.print(" ");
    Serial.print(((cmd >> DB5-1) & 1));
    Serial.print(" ");
    Serial.print(((cmd >> DB6-1) & 1));
    Serial.print(" ");
    Serial.print(((cmd >> DB7-1) & 1));
    Serial.print(" ");
    Serial.print(((cmd >> DI-1) & 1));
    Serial.print(" ");
    Serial.print(((cmd >> RW-1) & 1));
    Serial.print(" ");
    Serial.print(((cmd >> E-1) & 1));
    Serial.print(" ");
    Serial.print(((cmd >> CS1-1) & 1));
    Serial.print(" ");
    Serial.println(((cmd >> CS2-1) & 1));
    Serial.println("");
}

void lcd_goto(byte x, byte y){


    lcd_x = x;
    lcd_y = y;

    
	if(y > 63){
		chipselect = 1 << (CS2 - 1);
		y-=64;
        lcd_chip = 2;
	}else{
		chipselect = 1 << (CS1 - 1);
        lcd_chip = 1;
	}
    

    lcd_cmd(cmd_sety | set_data_bits(y) | chipselect);
    lcd_cmd(cmd_setx | set_data_bits(x) | chipselect);
}

void lcd_write(byte data){

    if(!chipselect) lcd_goto(0,0);

    if(lcd_y > 127 && lcd_chip == 2 && newline == 0) {
        return;
    }else{
        lcd_cmd(cmd_write | set_data_bits(data) | chipselect);
    };

    lcd_y++;
    if(lcd_y > 63 && lcd_chip == 1) lcd_goto(lcd_x,lcd_y);

    if(lcd_y > 127 && lcd_chip == 2 && newline == 1) {
        lcd_x++;
        lcd_goto(lcd_x,0);
    };
}

void lcd_letter (byte c){
  if (c < 0x20 || c > 0xBF) return;  
  c -= 0x20; 
  for (byte x = 0; x < 5; x++) lcd_write (pgm_read_byte (&font [c] [x]));
  	lcd_write (0);   //пробел в пиксель между символами
} 

void lcd_string (const char * s){
  char c;
  while (c = *s++) lcd_letter(c); 
} 

void lcd_bigfont_string (const char *s){
  char c;
  while (c = *s++){ 
     lcd_bigfont_letter(c); 
     lcd_goto(lcd_x-1,lcd_y+2);
 };
}

void lcd_bigfont_letter (byte c){
  if (c < 0x2B || c > 0x3A) return;  
  c -= 0x2B; 
  for (byte x = 0; x < 16; x++){
        if(x == 8)lcd_goto(lcd_x+1,lcd_y-8);
        lcd_write (pgm_read_byte (&tf [c] [x]));
    };
} 

uint8_t lcd_read(){
    uint8_t read_data = 0;
    set_data_pinmode(1); //переключение пинов mcp на чтение (input)
    mcpchip.digitalWrite(cmd_read | chipselect);   //Команда на чтение
    mcpchip.digitalWrite(cmd_read | chipselect | (1 << (E-1))); //Дрыг линией Е
    mcpchip.digitalWrite(cmd_read | chipselect);   //Линию Е обратно в 0, данные в защелку
    mcpchip.digitalWrite(cmd_read | chipselect | (1 << (E-1))); //Дрыг линией Е
    read_data=mcpchip.byteRead(GPIOB);  //пока поднято читаем. Все ноги DB на порте GPOIB. Иначе надо переделать.
    mcpchip.digitalWrite(cmd_read | chipselect);   //Линию Е обратно в 0
    set_data_pinmode(0);
    return read_data;
}

void set_data_pinmode(uint8_t mode){
        mcpchip.pinMode(DB0,mode);
        mcpchip.pinMode(DB1,mode);
        mcpchip.pinMode(DB2,mode);
        mcpchip.pinMode(DB3,mode);
        mcpchip.pinMode(DB4,mode);
        mcpchip.pinMode(DB5,mode);
        mcpchip.pinMode(DB6,mode);
        mcpchip.pinMode(DB7,mode);
}

void lcd_hline(byte from_y, byte to_y, byte x){

    uint8_t page = x / 8;
    uint8_t bit = x % 8;
    uint8_t data = 0;

    if(from_y < 0) from_y = 0;
    if(from_y > 127) from_y = 127;
    if(to_y > 127) to_y = 127;
    if(to_y < 0) to_y = 0;

    if(!(to_y > from_y)) to_y=from_y;
 
    for(int i=from_y;i <= to_y; i++){
            lcd_goto(page,i);
            data=lcd_read();
            lcd_goto(page,i);
            lcd_write(data | (1 << bit));
        }


}

void lcd_vline(byte from_x, byte to_x, byte y){

    uint8_t from_page = from_x / 8;
    uint8_t from_bit = from_x % 8;
    uint8_t to_page = to_x / 8;
    uint8_t to_bit = to_x % 8;

    uint8_t limit = 0;

    uint8_t data = 0;

    if(from_x < 0) from_x = 0;
    if(from_x > 7) from_x = 7;
    if(to_x > 7) to_x = 7;
    if(to_x < 0) to_x = 0;

    if(!(to_x > from_x)) to_x=from_x;

    if((to_page - from_page) == 0 ){   //сколько дорисовывать, доконца страницы или до бита, если нарисовать надо пару точек
        limit=to_bit - from_bit;
    }else{
        limit=7; 
    }

    //Дорисовали остаток начальной страницы
    for(int i = from_bit; i <= limit; i++){
            lcd_goto(from_page,y);
            data=lcd_read();
            lcd_goto(from_page,y);
            lcd_write(data | (1 << i));
    }

    while(from_page != to_page){
            from_page++;
            if(to_page - from_page > 0){
                lcd_goto(from_page,y);
                lcd_write(255);
            }else{
            for(int i = 0; i <= to_bit; i++){
                    lcd_goto(from_page,y);
                    data=lcd_read();
                    lcd_goto(from_page,y);
                    lcd_write(data | (1 << i));
                }
            }
    }
}